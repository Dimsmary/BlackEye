#include <SPI.h>
#include "nRF24L01.h"
#include "RF24.h"
#include "printf.h"
#include <Wire.h>
#include <Adafruit_GFX.h>
#include <Adafruit_SSD1306.h>
// 引用了SPI/NRF/oled库

#define SCREEN_WIDTH 128
#define SCREEN_HEIGHT 32
// 定义屏幕分辨率

static const unsigned char PROGMEM black_icon[]  = {0x00,0x00,0x00,0x00,0x00,0x00,0x00,0x00,0x00,0x00,
0x00,0x00,0x00,0x00,0x00,0x00,0x00,0x00,0x00,0x00,0x00,0x00,0x00,0x00,0x00,0x00,0x00,0x00,
0x00,0x00,0x00,0x00,0x00,0x00,0x00,0x00,0x00,0x00,0x00,0x00,0x00,0x00,0x00,0x00,0x00,0x00,
0x00,0x00,0x00,0x20,0x00,0x00,0x01,0x00,0x00,0x00,0x00,0x00,0x00,0x00,0x00,0x00,0x00,0x00,
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0x00,0x0c,0x20,0x01,0x0c,0x00,0x00,0x00,0x00,0x00,0x00,0x00,0x00,0x00,0x00,0x00};

static const unsigned char PROGMEM wait_icon[] = {0x00,0x00,0x00,0x00,0x00,0x00,0x00,0x00,0x00,
0x00,0x00,0x00,0x00,0x00,0x00,0x00,0x00,0x00,0x00,0x00,0x00,0x00,0x00,0x00,0x00,0x00,0x00,0x00,
0x00,0x00,0x00,0x00,0x00,0x01,0xf8,0x00,0x00,0x00,0x00,0x00,0x00,0x00,0x00,0x00,0x00,0x00,0x00,
0x00,0x00,0x07,0x80,0x00,0x00,0x00,0x00,0x00,0x00,0x00,0x00,0x00,0x00,0x00,0x00,0x00,0x00,0x0c,
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0x00,0x00,0x00,0x00,0x00,0x00,0x00,0x00,0x00};

static const unsigned char PROGMEM main_icon[] = {0x00,0x00,0x00,0x00,0x00,0x00,0x00,0x00,0x00,0x00,
0x00,0x00,0x00,0x00,0x00,0x00,0x00,0x00,0x00,0x00,0x00,0x00,0x00,0x1e,0x00,0x00,0x00,0x00,0x00,0x00,
0x00,0x00,0x1f,0xc0,0x00,0x00,0x00,0x00,0x00,0x21,0x00,0x00,0x00,0x00,0x00,0x00,0x00,0x00,0x1f,0xe0,
0x00,0x00,0x00,0x00,0x00,0xff,0xc0,0x00,0x00,0x00,0x00,0x00,0x00,0x00,0x1f,0xe0,0x00,0x00,0x00,0x00,
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0x00,0x00};

Adafruit_SSD1306 display(SCREEN_WIDTH, SCREEN_HEIGHT, &Wire, -1);
// 开启OLED

const uint64_t pipes[2] = { 0xABCDABCD71LL, 0x544d52687CLL }; 
// 定义了NRF传输地址

unsigned char key_sta[2] = {0, 0};
RF24 radio(13, 5);
// 设置NRF接口，使用默认SPI端口，4-CE / 5-CSN

const int buttonPin1 = 0;
const int buttonPin2 = 1;
const int buttonPin3 = 7;
// 按钮中断脚

byte button1_STA = LOW;
int buttonState1 = 0;
int lastButtonState1 = 1;

byte button2_STA = LOW;
int buttonState2 = 0;
int lastButtonState2 = 1;

byte button3_STA = LOW;
int buttonState3 = 0;
int lastButtonState3 = 1;

// 按钮中断变量

const long command1 = 4096;
const long command2 = 8192;
const long command3 = 12288;
const long command4 = 16384;
const long command5 = 20480;
const long command6 = 24576;
const long command7 = 28672;
const long command8 = 32768;
// 命令列表

long Timer = 0;
// 用于刷新计时
char if_connect = 0;
// 用于判断连接状态
char flip = 0;
// searching的翻转
int time_out = 0;

void setup(){
  Serial.begin(115200);
  // 启用串口
  printf_begin();
  // 启用printf
  
  radio.begin();
  radio.setAutoAck(1);
  radio.enableAckPayload();
  // 允许可选ACK载荷
  // 启用NRF-ACK
  radio.setRetries(0,15);
  // 设定重试最小时间，最大重试次数
  radio.openWritingPipe(pipes[0]);
  radio.stopListening();
  // 切换到发送模式

  pinMode(A0, INPUT);
  pinMode(A1, INPUT);
// 初始化电位器读取

  pinMode(buttonPin1, INPUT_PULLUP);
  pinMode(buttonPin2, INPUT_PULLUP);
  pinMode(buttonPin3, INPUT_PULLUP);
// 初始化按钮中断输入

  attachInterrupt(digitalPinToInterrupt(buttonPin1), switch1, CHANGE);
  attachInterrupt(digitalPinToInterrupt(buttonPin2), switch2, CHANGE);
  attachInterrupt(digitalPinToInterrupt(buttonPin3), switch3, CHANGE);
// 配置中断
  display.begin(SSD1306_SWITCHCAPVCC, 0x3C);
// 开启OLED
  display.clearDisplay();
  display.drawBitmap(0, 0, black_icon, 128, 64, 1);
  display.display();
  display.clearDisplay();
  delay(2000);
}

long SendData(long data){
  long gotdata;
  //定义
  if (!radio.write(&data, sizeof(data))){
      return 0;
      Serial.println("Not Sent.");
      // 未发送成功      
  }else{
    if(!radio.available()){ 
      return 0; 
      Serial.println("Empty.");
      // 发送成功但ack为空
    }else{
      while(radio.available() ){
        radio.read( &gotdata, sizeof(gotdata));
      }
      Serial.println("Success Get ack.");
      Serial.println(gotdata);
      return gotdata;
    }
  }
return 0;
}

void loop(){
  int potValueY = analogRead(A0);
  int potValueX = analogRead(A1);
  long angleValueX = map(potValueX, 0, 1023, 0, 180);
  long angleValueY = map(potValueY, 0, 1023, 0, 180);
  // 读取电位器并与舵机角度匹配 后方为高位识别命令码
  
  if (angleValueX > 95){
    SendData(command1);
  }
  else if(angleValueX < 85){
    SendData(command2);
  }
  if (angleValueY > 95){
    SendData(command3);
  }
  else if(angleValueY < 85){
    SendData(command4);
  }

  
// 发送操控命令
  
  // 按键中断检测
  if (buttonState1 == HIGH){
    buttonState1 = LOW;
    SendData(command5);
  }
  if (buttonState2 == HIGH){
    buttonState2 = LOW;
    SendData(command6);
  }
  if (buttonState3 == HIGH){
    buttonState3 = LOW;
    SendData(command8);

  }
  // 按键中断处理


  Timer++;

  long recv;
  if(Timer == 3000){
    Timer = 0;
    if(if_connect){
      // 侦测到黑眼
      recv = SendData(command7);
      Serial.println(recv >> 12 == 7);
      if(recv >> 12 == 7){
      display.clearDisplay();
      display.drawBitmap(0, 0, main_icon, 128, 64, 1);

      int ADC_value = recv & 255;
      int speed_value = recv & 3072;
      int servo_value = recv & 256;
      int cam_value = recv & 512;
      // 解码各个回传数值
      
      float adc_5v = 0.0537 * (float)ADC_value;
      // 把1024转5V
      

      display.setTextSize(2);
      display.setTextColor(WHITE);
      display.setCursor(3, 13);
      display.println(adc_5v);

      display.setTextSize(1);
      display.setCursor(67, 23);

      if(speed_value == 0){
        display.println("SPEED:1");
      }
      else if(speed_value == 1024){
        display.println("SPEED:2");
      }
      else if(speed_value == 2048){
        display.println("SPEED:3");
      }
      else if(speed_value == 3072){
        display.println("SPEED:4");
      }
      // 判断速度
      
      display.setCursor(67, 13);
      if(servo_value){
        display.println("SERVO:ON");
      }
      else{
        display.println("SERVO:OFF");
      }
      display.setCursor(67, 3);
      if(cam_value){
        display.println("CAMERA:ON");
      }
      else{
        display.println("CAMERA:OFF");
      }
      display.display();
      }
      else{
        time_out ++;
        if(time_out == 10){
          time_out = 0;
          if_connect = 0;
          display.clearDisplay();
        }
      }

    }else{
      // 若没有侦测到黑眼
      if(flip){
        display.drawBitmap(0, 0, wait_icon, 128, 64, 1);
        display.setTextSize(1);
        display.setTextColor(WHITE);
        display.setCursor(45, 13);
        display.println("Searching...");
        display.display();
      }else{
        display.fillRect(45, 13, 128, 20, BLACK);
        display.display();
      }
      flip = !flip;
      // 翻转searching状态
      recv = SendData(command7);
      Serial.println(recv);
      if(recv >> 12 == 7){
        if_connect = 1;
        // 更改为已连接 
      }
    }
    
  }  
}

void switch1(){
  buttonState1 = digitalRead(buttonPin1);
  // 与上一次检测到的状态对比
  if (buttonState1 != lastButtonState1) {
    // 如果检测到状态改变
    if (buttonState1 == HIGH) {
      // 高电平为松开   
      Serial.println("off");
    } else {
      // 低电平为按下
      button1_STA = HIGH;
      // 标志位
      Serial.println("on");
    }
    //消抖
    delay(50);
  }
  // 每次改变都保存状态检测改变
  lastButtonState1 = buttonState1;
}

void switch2(){
  buttonState2 = digitalRead(buttonPin2);
  if (buttonState2 != lastButtonState2) {
    if (buttonState2 == HIGH) { 
      Serial.println("off");
    } else {
      button2_STA = HIGH;
      // 标志位
      Serial.println("on");
    }
    delay(50);
  }
  lastButtonState2 = buttonState2;
  // 原理同Switch1
}

void switch3(){
  buttonState3 = digitalRead(buttonPin3);
  if (buttonState3 != lastButtonState3) {
    if (buttonState3 == HIGH) { 
      Serial.println("off");
    } else {
      button3_STA = HIGH;
      // 标志位
      Serial.println("on");
    }
    delay(50);
  }
  lastButtonState3 = buttonState3;
  // 原理同Switch1
}
